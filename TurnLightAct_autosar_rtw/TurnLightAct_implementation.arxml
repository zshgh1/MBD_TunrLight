AUTOSAR XML (schema 4-3-1)
package /ComponentTypes
  swc implementation TurnLightAct_imp: programming-language=C, sw-version=1.4.1, used-code-generator=Embedded Coder 7.10 (R2023a) 19-Nov-2022, vendor-id=0, behavior=TurnLightAct_InternalBehavior
    code-descriptors:
      code Code
        artifact-descriptors:
          short-label=TurnLightAct_c, category=SWSRC
          short-label=TurnLightAct_h, category=SWHDR
          short-label=TurnLightAct_private_h, category=SWHDR
          short-label=TurnLightAct_types_h, category=SWHDR
          short-label=rtwtypes_h, category=SWHDR
    resource consumption RsrcCons_TurnLightAct
