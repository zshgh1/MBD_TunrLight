AUTOSAR XML (schema 4-3-1)
package /AUTOSAR_Platform/ImplementationDataTypes
  impl type TurnLightService: category=STRUCTURE
    7 x element, all with category=TYPE_REFERENCE:
      TurnLightPosition: implementation-data-type=ComplexTurnLightPosition
      TurnLightOnOff: implementation-data-type=ComplexTurnLightOnOff
      TurnLightDutyCycle: implementation-data-type=uint8
      TurnLightCycle: implementation-data-type=uint8
      TurnLightTimes: implementation-data-type=uint8
      TurnLightNumber: implementation-data-type=uint8
      TurnLightPriority: implementation-data-type=uint8
  impl type ComplexTurnLightPosition: category=VALUE, base-type=uint8, range raw 0..255
  impl type ComplexTurnLightOnOff: category=VALUE, base-type=uint8, range raw 0..255
package /AUTOSAR_Platform/ImplementationDataTypes/ApplDataTypes
  app type ComplexTurnLightPosition: category=VALUE, sw-calibration-access=READ-WRITE, compu {0=POS_NOREQUEST, 1=LEFT, 2=RIGHT, 3=ALL, 4=FRONT_LEFT, 5=MIDDLE_LEFT, 6=REAR_LEFT, 7=FRONT_RIGHT, 8=MIDDLE_RIGHT, 9=REAR_RIGHT}
  app type ComplexTurnLightOnOff: category=VALUE, sw-calibration-access=READ-WRITE, compu {0=ONOFF_NOREQUEST, 1=OFF, 2=ON}
  app type uint8: category=VALUE, sw-calibration-access=READ-WRITE, compu {identical}, range phys 0..255
  application record data type TurnLightService: category=STRUCTURE, sw-calibration-access=READ-WRITE
    7 x application record element, all with category=VALUE:
      TurnLightPosition: type=ComplexTurnLightPosition
      TurnLightOnOff: type=ComplexTurnLightOnOff
      TurnLightDutyCycle: type=uint8
      TurnLightCycle: type=uint8
      TurnLightTimes: type=uint8
      TurnLightNumber: type=uint8
      TurnLightPriority: type=uint8
package /AUTOSAR_Platform/ImplementationDataTypes/DataTypeMappings
  data type mapping set TurnLightLogicDataTypeMappingsSet
    data-type-maps:
      application-data-type=ComplexTurnLightPosition, implementation-data-type=ComplexTurnLightPosition
      application-data-type=ComplexTurnLightOnOff, implementation-data-type=ComplexTurnLightOnOff
      application-data-type=uint8, implementation-data-type=uint8
      application-data-type=TurnLightService, implementation-data-type=TurnLightService
package /AUTOSAR_Platform/ImplementationDataTypes/Units
  unit NoUnit: factor-si-to-unit=1, offset-si-to-unit=0
