AUTOSAR XML (schema 4-3-1)
package /ComponentTypes
  swc implementation TurnLightLogic_imp: programming-language=C, sw-version=1.16.1, used-code-generator=Embedded Coder 7.10 (R2023a) 19-Nov-2022, vendor-id=0, behavior=TurnLightLogic_InternalBehavior
    code-descriptors:
      code Code
        artifact-descriptors:
          short-label=TurnLightLogic_c, category=SWSRC
          short-label=TurnLightLogic_h, category=SWHDR
          short-label=TurnLightLogic_private_h, category=SWHDR
          short-label=TurnLightLogic_types_h, category=SWHDR
          short-label=rtwtypes_h, category=SWHDR
    resource consumption RsrcCons_TurnLightLogic
