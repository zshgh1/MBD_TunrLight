AUTOSAR XML (schema 4-3-1)
package /ComponentTypes
  swc implementation TurnLightArb_imp: programming-language=C, sw-version=1.8.1, used-code-generator=Embedded Coder 7.10 (R2023a) 19-Nov-2022, vendor-id=0, behavior=TurnLightArb_InternalBehavior
    code-descriptors:
      code Code
        artifact-descriptors:
          short-label=TurnLightArb_c, category=SWSRC
          short-label=TurnLightArb_h, category=SWHDR
          short-label=TurnLightArb_private_h, category=SWHDR
          short-label=TurnLightArb_types_h, category=SWHDR
          short-label=rtwtypes_h, category=SWHDR
          short-label=turnlightservice_turnlightcontrol_operation_operation_1_private_h, category=SWHDR
    resource consumption RsrcCons_TurnLightArb
