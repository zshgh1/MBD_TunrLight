AUTOSAR XML (schema 4-3-1)
package /PortInterfaces
  client server interface turnlightservice_turnlightcontrol_operation_operation_1
    operation turnlightservice_turnlightcontrol_operation_operation_1
      arg TurnLightCtrlPara: category=STRUCTURE, sw-calibration-access=READ-ONLY, type=TurnLightService, direction=IN
