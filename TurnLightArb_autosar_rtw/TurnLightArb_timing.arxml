AUTOSAR XML (schema 4-3-1)
package /Timing
  swc timing TurnLightArb_timing: behavior=TurnLightArb_InternalBehavior
    timing-requirements:
      execution order constraint EOC
        ordered-elements:
          eoc executable entity ref turnlightservice_turnlightcontrol_operation_operation_1: executable=turnlightservice_turnlightcontrol_operation_operation_1, successor=Runnable
          eoc executable entity ref Runnable: executable=Runnable
